## config/west.yml
```yaml
manifest:
  remotes:
    - name: zmkfirmware
      url-base: https://github.com/zmkfirmware
    - name: duckyb
      url-base: https://github.com/duckyb
    - name: urob
      url-base: https://github.com/urob
  projects:
    - name: zmk
      remote: zmkfirmware
      revision: 
      import: app/west.yml

    - name: urchin-zmk-module
      remote: duckyb
      revision: 

    - name: zmk-helpers
      remote: urob
      revision: 
  self:
    path: config
```
